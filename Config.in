## configs/px30_defconfig
```kconfig
#include "audio.config"
#include "base.install"
#include "base.config"
#include "camera.config"
#include "debug.install"
#include "gpu.config"
#include "graphics.config"
#include "gst_audio.config"
#include "gst_camera.config"
#include "gst_video.config"
#include "qtapp.config"
#include "video.config"
#include "wifi.config"
BR2_PACKAGE_RKWIFIBT_AP6212A1=y
BR2_PACKAGE_RKWIFIBT_BTUART="ttyS1"
# BR2_PACKAGE_MULTICAMERA is not set
# BR2_PACKAGE_MULTIVIDEOPLAYER is not set
```

## configs/rk3328_defconfig
```kconfig
#include "audio.config"
#include "base.install"
#include "base.config"
#include "debug.install"
#include "gpu.config"
#include "graphics.config"
#include "gst_audio.config"
#include "gst_camera.config"
#include "gst_video.config"
#include "qtapp.config"
#include "video.config"
#include "wifi.config"
BR2_PACKAGE_RKWIFIBT_AP6356=y
BR2_PACKAGE_RKWIFIBT_BTUART="ttyS0"
BR2_PACKAGE_RKSCRIPT_DEFAULT_PCM="rockchiphdmi"
```

## package/board/Config.in
```kconfig
config BR2_PACKAGE_BOARD
	bool "Private config for special board"
	help
	  "Private config for special board"

if BR2_PACKAGE_BOARD

config BR2_PACKAGE_BOARD_RK3328_EVB
	bool "RK3328 EVB"
	help
	  "RK3328_EVB"

endif
```
